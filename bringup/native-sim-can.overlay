/*
 * Point native_sim at the Linux SocketCAN bridge instead of the in-process
 * loopback, so firmware under test shares a bus with the host runtime.
 *
 * Set the interface up first:
 *   sudo modprobe vcan can-isotp
 *   sudo ip link add dev vcan0 type vcan
 *   sudo ip link set up vcan0
 *   sudo ip link property add dev vcan0 altname zcan0
 *
 * The altname is what makes this work unmodified: native_sim's own DTS names
 * the host interface "zcan0", and its comment documents this exact trick.
 */
&can0 {
	status = "okay";
};

/ {
	chosen {
		zephyr,canbus = &can0;
	};
};
