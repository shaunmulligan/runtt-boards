## CMakeLists.txt
```
cmake_minimum_required(VERSION 3.20.0)
find_package(Zephyr REQUIRED HINTS $ENV{ZEPHYR_BASE})
project(runtt_idle LANGUAGES C VERSION 0.0.0)
target_sources(app PRIVATE src/main.c)
```

## sysbuild.conf
```
../sysbuild-common.conf
```

## prj.conf
```kconfig
# runtt-idle: what ships in slot 0 at provisioning time.
#
# Kept separate from app/ deliberately; see the note in app/prj.conf. In short:
# this one is a shipped artefact and is sized accordingly, while app/ is the test
# fixture and has to keep logging for the runtime's gates to have anything to
# assert on.
#
# Its whole job is to make a freshly provisioned board VISIBLE. It enumerates,
# answers describe, accepts an image, and otherwise does nothing.

# Says "this is the provisioning placeholder, not the customer's firmware", so
# the runtime can report a board awaiting its first release as exactly that
# rather than as unrecognised firmware.
CONFIG_RUNTT_IDLE=y

# Deliberately minimal: this image is replaced by the first real deploy, so
# every byte it occupies is wasted flash and a slower provisioning write.
CONFIG_LOG=y
CONFIG_LOG_MODE_MINIMAL=y
CONFIG_MAIN_STACK_SIZE=1024
```

## src/main.c
```c
/*
 * Copyright (c) 2026 The runtt authors
 * SPDX-License-Identifier: MIT OR Apache-2.0
 *
 * runtt-idle: the application that ships in slot 0 at provisioning time.
 *
 * It does nothing, on purpose. What matters is what it makes possible: a board
 * carrying it enumerates, answers `describe`, and accepts an image upload.
 *
 * The alternative is worse than it sounds. MCUboot with an empty primary slot
 * halts, and having no USB of its own it does so completely silently -- no
 * enumeration, no device node, nothing. Such a board is indistinguishable from
 * one that is unplugged, unpowered or dead, and diagnosing it needs a wire to a
 * UART. With this image present the same board shows up as a service reporting
 * a clear error, which is the difference between a five-minute diagnosis and an
 * afternoon.
 *
 * Everything that makes it manageable comes from the runtt module. There is
 * deliberately nothing here.
 */
#include <zephyr/kernel.h>
#include <zephyr/logging/log.h>

LOG_MODULE_REGISTER(idle, LOG_LEVEL_INF);

int main(void)
{
	LOG_INF("runtt-idle on %s: provisioned, awaiting first firmware",
		CONFIG_BOARD_TARGET);

	/* Sleep forever. The SMP server runs on its own thread, so the runtime
	 * can talk to this board and replace it whenever it likes.
	 */
	while (1) {
		k_sleep(K_FOREVER);
	}

	return 0;
}
```
