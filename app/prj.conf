## CMakeLists.txt
```
cmake_minimum_required(VERSION 3.20.0)

find_package(Zephyr REQUIRED HINTS $ENV{ZEPHYR_BASE})
project(runtt_app LANGUAGES C VERSION 0.1.0)

target_sources(app PRIVATE src/main.c)
```

## sysbuild.conf
```
# Sysbuild configuration for hardware targets.

SB_CONFIG_BOOTLOADER_MCUBOOT=y

# Pin the swap mode rather than inheriting the default. It changed to
# swap-using-offset recently, and a bootloader built for one mode cannot boot an
# image built for the other (zephyr#98050). Since sysbuild builds both together
# they always agree here, but a Zephyr bump must not silently change the
# on-device contract.
SB_CONFIG_MCUBOOT_MODE_SWAP_USING_OFFSET=y

# ---------------------------------------------------------------------------
# SIGNING: development only. Do not ship this.
# ---------------------------------------------------------------------------
# Stated explicitly rather than left to the default, because the default is
# dangerous in a way that looks fine: sysbuild silently selects RSA-2048 with
# MCUboot's own root-rsa-2048.pem, and that file is the PRIVATE key, committed
# in the public MCUboot repository.
#
# The consequence is not subtle. Flashing MCUboot is what enrols the trust root:
# the embedded key defines whose firmware the board will ever accept. With a
# publicly known private key, no trust is enrolled at all -- anyone who can
# reach the SMP transport can push firmware the bootloader will happily verify
# and boot. `imgtool verify` will even report "Image was correctly validated",
# which is exactly why this needs saying out loud.
#
# For the PoC that is an accepted, deliberate trade. Before any fleet:
#   * generate a per-fleet key pair and keep the private half out of the repo;
#   * point SB_CONFIG_BOOT_SIGNATURE_KEY_FILE at it via the build environment;
#   * remember the public half is baked into MCUboot at provisioning time, so
#     rotating it means re-flashing over SWD -- key management is a
#     provisioning decision, not a build-time one.
SB_CONFIG_BOOT_SIGNATURE_TYPE_RSA=y
```

## prj.conf
```kconfig
# The reference application.
#
# WHY THIS IS NOT idle/ -- the question looks like duplication and is not.
#
# The two have conflicting jobs. idle/ ships inside every provisioning image, so
# it is minimal and silent: one log line, then sleep forever. This one is the
# fixture the runtime's end-to-end gates run against, and those gates assert that
# application output reaches the log channel -- the CAN gate greps for a
# RECURRING line, because a raw CAN log channel has no backlog and a one-shot
# startup message would be a race against the listener attaching.
#
# So one must be quiet and small and the other must keep talking. A single
# application cannot be both, and a config flag switching between them would put
# the provisioning payload's size at the mercy of the test fixture's needs.
#
# Everything that makes this manageable by the runtime comes from the snippet
# (`-S runtt`), not from here. This file is what a customer's own
# application config would look like: ordinary, with no platform boilerplate.

CONFIG_LOG=y
CONFIG_LOG_MODE_IMMEDIATE=y
CONFIG_MAIN_STACK_SIZE=2048
CONFIG_SYSTEM_WORKQUEUE_STACK_SIZE=2560
```

## src/main.c
```c
/*
 * Copyright (c) 2026 The runtt authors
 * SPDX-License-Identifier: MIT OR Apache-2.0
 *
 * Template application.
 *
 * Deliberately boring: it logs and it feeds the liveness watchdog. Everything
 * that makes it deployable as a container -- the SMP server, the two channels,
 * the describe command -- comes from the `balena-mcu` snippet, so this is what
 * a customer's existing firmware looks like after adopting the platform.
 */
#include <zephyr/kernel.h>
#include <zephyr/logging/log.h>
#include <app_version.h>

#ifdef CONFIG_BALENA_MCU_HEALTH
#include <balena_mcu/health.h>
#endif

LOG_MODULE_REGISTER(app, LOG_LEVEL_INF);

int main(void)
{
	uint32_t tick = 0;

	/* Goes to the log channel, which the runtime pipes to container stdio,
	 * which is what `docker logs` shows. This line is the whole feature.
	 */
	LOG_INF("balena-mcu template app %s starting on %s", APP_VERSION_STRING,
		CONFIG_BOARD_TARGET);

	while (1) {
#ifdef CONFIG_BALENA_MCU_HEALTH
		balena_mcu_health_feed();
#endif
		LOG_INF("alive, tick %u", tick++);
		k_sleep(K_SECONDS(2));
	}

	return 0;
}
```
